## conf/layer.conf
```bitbake
# We have a conf and classes directory, append to BBPATH
BBPATH .= ":${LAYERDIR}"

# We have recipes-* directories, add to BBFILES
BBFILES += "${LAYERDIR}/recipes-*/*/*.bb ${LAYERDIR}/recipes-*/*/*.bbappend"

BBFILE_COLLECTIONS += "isoblue-demos"
BBFILE_PATTERN_isoblue-demos = "^${LAYERDIR}/"
BBFILE_PRIORITY_isoblue-demos = "90"

LAYERDEPENDS_isoblue-demos = " \
    core \
    openembedded-layer gnome-layer multimedia-layer networking-layer \
    angstrom-layer \
    browser-layer \
    freescale-layer \
    fsl-demos \
    toradex-demos \
    lxde-layer \
    qt4-layer \
    qt5-layer \
    \
    isoblue-layer \
"
```
